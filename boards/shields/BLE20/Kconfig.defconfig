## boards/shields/BLE20/Kconfig.defconfig
```kconfig
# Copyright (c) 2021 The ZMK Contributors
# SPDX-License-Identifier: MIT

if SHIELD_BLE20_LEFT

config ZMK_KEYBOARD_NAME
    default "BLE20"

config ZMK_SPLIT_ROLE_CENTRAL
    default y

endif

if SHIELD_BLE20_LEFT || SHIELD_BLE20_RIGHT

config ZMK_SPLIT
    default y

endif
```

## boards/shields/BLE20/Kconfig.shield
```kconfig
# Copyright (c) 2021 The ZMK Contributors
# SPDX-License-Identifier: MIT

config SHIELD_BLE20_LEFT
    def_bool $(shields_list_contains,BLE20_left)

config SHIELD_BLE20_RIGHT
    def_bool $(shields_list_contains,BLE20_right)
```

## config/boards/shields/BLE28/Kconfig.defconfig
```kconfig
# Copyright (c) 2021 The ZMK Contributors
# SPDX-License-Identifier: MIT

if SHIELD_BLE28_LEFT

config ZMK_KEYBOARD_NAME
    default "BLE28"

config ZMK_SPLIT_ROLE_CENTRAL
    default y

endif

if SHIELD_BLE28_LEFT || SHIELD_BLE28_RIGHT

config ZMK_SPLIT
    default y

endif
```

## config/boards/shields/BLE28/Kconfig.shield
```kconfig
# Copyright (c) 2021 The ZMK Contributors
# SPDX-License-Identifier: MIT

config SHIELD_BLE28_LEFT
    def_bool $(shields_list_contains,BLE28_left)

config SHIELD_BLE28_RIGHT
    def_bool $(shields_list_contains,BLE28_right)
```
